## config/boards/arm/Hele/Kconfig.board
```kconfig
# Hele board configuration

# Copyright (c) 2020 Kagen Aeby (Kikokeyco)
# SPDX-License-Identifier: MIT

config BOARD_HELE
	bool "Hele"
	depends on SOC_NRF52840_QIAA
```

## config/boards/arm/Hele/hele_defconfig
```kconfig
# SPDX-License-Identifier: MIT

CONFIG_SOC_SERIES_NRF52X=y
CONFIG_SOC_NRF52840_QIAA=y
CONFIG_BOARD_HELE=y

# Enable MPU
CONFIG_ARM_MPU=y

# enable GPIO
CONFIG_GPIO=y
CONFIG_USE_DT_CODE_PARTITION=y

# enable pwm
# CONFIG_PWM=y

CONFIG_MPU_ALLOW_FLASH_WRITE=y
CONFIG_NVS=y
CONFIG_SETTINGS_NVS=y
CONFIG_FLASH=y
CONFIG_FLASH_PAGE_LAYOUT=y
CONFIG_FLASH_MAP=y

# set TX power level
CONFIG_BT_CTLR_TX_PWR_PLUS_8=y // Recommended if used in a metal enclosure

# Enable Underglow
CONFIG_ZMK_RGB_UNDERGLOW=n
CONFIG_WS2812_STRIP=n
CONFIG_ZMK_RGB_UNDERGLOW_EXT_POWER=n
CONFIG_ZMK_RGB_UNDERGLOW_ON_START=n
```

## config/boards/arm/Keeber/Kconfig.board
```kconfig
# Keeber board configuration

# Copyright (c) 2020 Kagen Aeby (Kikokeyco)
# SPDX-License-Identifier: MIT

config BOARD_KEEBER
	bool "Keeber"
	depends on SOC_NRF52840_QIAA
```

## config/boards/arm/Keeber/Kconfig.defconfig
```kconfig
# Copyright (c) 2020 Kagen Aeby (Kikokeyco)
# SPDX-License-Identifier: MIT

if BOARD_KEEBER

config ZMK_KEYBOARD_NAME
	default "Hele"

if USB

config USB_NRFX
	default y

config USB_DEVICE_STACK
	default y

endif # USB

config BT_CTLR
	default BT

config ZMK_BLE
	default y

config ZMK_USB
	default y
	
config ZMK_BATTERY_VOLTAGE_DIVIDER
	default y

endif # BOARD_KEEBER
```
